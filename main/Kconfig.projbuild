## main/Kconfig.projbuild
```kconfig
menu "Example Configuration"

    config BLINK_GPIO
        int "Blink GPIO number"
        range 0 34
        default 5
        help
            GPIO number (IOxx) to blink on and off.

            Some GPIOs are used for other purposes (flash connections, etc.) and cannot be used to blink.

            GPIOs 35-39 are input-only so cannot be used as outputs.

    config APP_PROJECT_VER
        string "APP PROJECT VER"
        default "latest"

    config APP_PROJECT_VER_FROM_CONFIG
        bool "APP_PROJECT_VER_FROM_CONFIG"
        default true

    config FIRMWARE_SERVER_URL
        string "FIRMWARE_SERVER_URL"
        default "http://caps-platform.live:3000/api/users/36/ota/download/firmware/latest.bin"
        
    config OTA_TOKEN
        string "OTA_TOKEN"
        default "eyJhbGciOiJSUzI1NiIsInR5cCI6IkpXVCJ9.eyJpYXQiOjE2ODQ1MDM5ODMsImlzcyI6ImlvdHBsYXRmb3JtIiwic3ViIjoiMzYvODYifQ.UspMi_MuAj7LIdNnflk4F3LTZXAark2-0qbJAsplaidWTstABjiXFgtOiKbxHMsxXD2BfQ1eevl6KqBbsgFgD3Y_-2tRxrTh3kDGdPibVCoabgu947Z006tNBzUDAN4jSnexQ-Q6rfJM2jGfyOs2yJbvyr7SP4_FVMQTx2MA6twV0KITvfgHgq76qV8jBsDWKTIgBtv1wNZtj4lbN2o8hND-IHo9KOntw35nqU8JmjwqF0VZ_bQZrpwJmSIAJTACldN3KKGRrXpIx_0gperDykNn7Ka9__ci3odxsFk4GjFhWImpr4o82BzWQz4OajfH9_rPwHOJpLIjLFyExpsZhbGgpI418bqmVeXe08CvRccCx44acn21VNe4aIsiPqIKh5A_msErAm_x7A11QvWhw8PA1R_Sk7gyKSjfBUQesnXgSW41jk8cFz4WtVUz9hSimjqPjJ26phQhCgr1rJymxhP9n5yduc7MUpRp3uqp6eWRk2reLcneJP5gfytuU2SkQSk1_eB4p3YLa1JZqM5IXuvQi-ErJY29v6ERXGbIKTu0zBctXf1wuEHzBdazxzXX6_USmmBzWBYPhUJ5pITJ-rWHaKW51mTNpvjEBLT9XHu4KodgAaSl0v9nIT2NKNhMja8Wtpo5SXxn1xynktwbbTjnMAw5PquHKpLw1-LYE0U"
        help
            To create this token, please login with your credentials and download the token from your device.
            This token can be the same as the one for sending messages to the IoT Platform.

endmenu
```
